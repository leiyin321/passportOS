## components/native_exec_pool/Kconfig
```kconfig
menu "C3 Native executable pool"
    config NATIVE_EXEC_POOL
        bool "Reserve a bounded executable pool while memory protection is locked"
        depends on IDF_TARGET_ESP32C3 && ESP_SYSTEM_MEMPROT_FEATURE && ESP_SYSTEM_MEMPROT_FEATURE_LOCK
        default n
    config NATIVE_EXEC_POOL_KIB
        int "Pool capacity (KiB)"
        depends on NATIVE_EXEC_POOL
        range 8 64
        default 16
    config NATIVE_EXEC_PROBE
        int "Protection fault probe: 0=normal, 1=heap execute, 2=OS text write"
        depends on NATIVE_EXEC_POOL
        range 0 2
        default 0
endmenu
```

## experiments/native_elf_c3/sdkconfig.defaults
```kconfig
CONFIG_IDF_TARGET="esp32c3"
CONFIG_ESPTOOLPY_FLASHSIZE_8MB=y
CONFIG_PARTITION_TABLE_SINGLE_APP=y
CONFIG_ELF_LOADER=y
CONFIG_ELF_LOADER_BUS_ADDRESS_MIRROR=n
CONFIG_ELF_LOADER_LIBC_SYMBOLS=n
CONFIG_ELF_LOADER_ESPIDF_SYMBOLS=n
CONFIG_ELF_LOADER_CUSTOMER_SYMBOLS=n
CONFIG_ESP_SYSTEM_MEMPROT_FEATURE=n
```
